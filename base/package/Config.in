## base/package/Config.in
```kconfig
	source "../base/package/silc_product/Config.in"
	source "../base/package/is_web/Config.in"
	source "../base/package/silc_common/Config.in"
	source "../base/package/silc_libedit/Config.in"
	source "../base/package/silc_mgmtd/Config.in"
	source "../base/package/silc_web/Config.in"
	source "../base/package/pam_radius/Config.in"
	source "../base/package/pam_tacplus/Config.in"
```

## base/package/is_web/Config.in
```kconfig
config BR2_PACKAGE_IS_WEB
	bool "is_web"
	select BR2_PACKAGE_SILC_WEB
	help
	  Silicom IS Web Interface.
```

## base/package/pam_radius/Config.in
```kconfig
config BR2_PACKAGE_PAM_RADIUS
	bool "pam_radius"
	help
	  PAM RADIUS authentication module.
```

## base/package/pam_tacplus/Config.in
```kconfig
config BR2_PACKAGE_PAM_TACPLUS
	bool "pam_tacplus"
	help
	  PAM TACACS+ authentication module.
```

## base/package/silc_common/Config.in
```kconfig
config BR2_PACKAGE_SILC_COMMON
	bool "silc_common"
	default y
	help
	    Silicom common OS wrapper C lib.
```

## base/package/silc_libedit/Config.in
```kconfig
config BR2_PACKAGE_SILC_LIBEDIT
	bool "silc_libedit"
	default y
	select BR2_PACKAGE_NCURSES
	help
	    Libedit lib for silicom mgmtd.
```

## base/package/silc_mgmtd/Config.in
```kconfig
config BR2_PACKAGE_SILC_MGMTD
	bool "silc_mgmtd"
	default y
	select BR2_SILC_PRODUCT
	select BR2_PACKAGE_NETSNMP
	select BR2_PACKAGE_SILC_COMMON
	select BR2_PACKAGE_SILC_LIBEDIT
	help
	    Silicom management daemon.
```

## base/package/silc_product/Config.in
```kconfig
config BR2_PACKAGE_SILC_PRODUCT
	bool "silc_product"
	default y
	help
	    Create /etc/product.txt which contains the product name
```

## base/package/silc_web/Config.in
```kconfig
config BR2_PACKAGE_SILC_WEB
	bool "silc_web"
	select BR2_PACKAGE_LUA
	select BR2_PACKAGE_LINUX_PAM
	select BR2_PACKAGE_SILC_MGMTD
	help
	  Silicom Web Interface.
```

## buildroot/boot/a3700-utils-marvell/Config.in
```kconfig
config BR2_TARGET_A3700_UTILS_MARVELL
	bool "a3700-utils-marvell"
	depends on BR2_aarch64
	help
	  Marvell Armada 37xx firmware code and utilities are kept in
	  a separate repository. This code is needed as a dependency
	  to build ATF firmware for Marvell Armada 37xx SoCs.

	  https://github.com/MarvellEmbeddedProcessors/A3700-utils-marvell/

choice
	bool "a3700-utils-marvell-version"

config BR2_TARGET_A3700_UTILS_MARVELL_CUSTOM_GIT
	bool "Custom Git repository"
	help
	  Allows to specify custom repository for the component
	  Useful for developers building out of bleeding edge sources

config BR2_TARGET_A3700_UTILS_MARVELL_RELEASE
	bool "Release repository on Github"
	help
	  Use the package sources specified in this buildroot release

config BR2_TARGET_A3700_UTILS_MARVELL_CUSTOM_TARBALL
	bool "Release sources supplied as archives"
	help
	  Use the package sources from local archive

endchoice

if BR2_TARGET_A3700_UTILS_MARVELL_CUSTOM_GIT

config BR2_TARGET_A3700_UTILS_MARVELL_CUSTOM_REPO_URL
	string "URL of custom repository"

config BR2_TARGET_A3700_UTILS_MARVELL_CUSTOM_REPO_VERSION
	string "Custom repository version"
	help
	  Revision to use in the typical format used by Git
	  E.G. a sha id, a tag, branch, ..

endif

config BR2_TARGET_A3700_UTILS_MARVELL_CUSTOM_TARBALL_LOCATION
	string "Name of local archive file with release"
```

## buildroot/boot/mv-ddr-marvell/Config.in
```kconfig
config BR2_TARGET_MV_DDR_MARVELL
	bool "mv-ddr-marvell"
	depends on BR2_aarch64
	help
	  Marvell keeps algorithms for DDR training in a separate
	  repository. This code is not built separately, it is needed
	  as a dependency to build ATF firmware for Marvell Armada 7040
	  and 8040 SoCs.

	  https://github.com/MarvellEmbeddedProcessors/mv-ddr-marvell/

choice
	bool "mv-ddr-marvell-version"

config BR2_TARGET_MV_DDR_MARVELL_CUSTOM_GIT
	bool "Custom Git repository"
	help
	  Allows to specify custom repository for the component
	  Useful for developers building out of bleeding edge sources

config BR2_TARGET_MV_DDR_MARVELL_RELEASE
	bool "Release repository on Github"
	help
	  Use the package sources specified in this buildroot release

config BR2_TARGET_MV_DDR_MARVELL_CUSTOM_TARBALL
	bool "Release sources supplied as archives"
	help
	  Use the package sources from local archive

endchoice

if BR2_TARGET_MV_DDR_MARVELL_CUSTOM_GIT

config BR2_TARGET_MV_DDR_MARVELL_CUSTOM_REPO_URL
	string "URL of custom repository"

config BR2_TARGET_MV_DDR_MARVELL_CUSTOM_REPO_VERSION
	string "Custom repository version"
	help
	  Revision to use in the typical format used by Git
	  E.G. a sha id, a tag, branch, ..

endif

config BR2_TARGET_MV_DDR_MARVELL_CUSTOM_TARBALL_LOCATION
	string "Name of local archive file with release"
```

## buildroot/package/libnetconf/Config.in
```kconfig
config BR2_PACKAGE_LIBNETCONF
	bool "libnetconf"
	select BR2_PACKAGE_PYANG
	select BR2_PACKAGE_LIBXML2
	select BR2_PACKAGE_LIBXSLT
	select BR2_PACKAGE_LIBSSH
	help
	  libnetconf is a NETCONF library in C intended for building NETCONF clients and servers.
```

## buildroot/package/netopeer/Config.in
```kconfig
config BR2_PACKAGE_NETOPEER
	bool "netopeer"
	select BR2_PACKAGE_LIBNETCONF
	select BR2_PACKAGE_PYTHON_CURSES
	help
	  The Netopeer NETCONF server follows the integrated architecture described at
	  [https://rawgit.com/CESNET/libnetconf/master/doc/doxygen/html/da/db3/server.html].
```

## buildroot/package/perl-crypt-openssl-x509/Config.in
```kconfig
config BR2_PACKAGE_PERL_CRYPT_OPENSSL_X509
	bool "perl-crypt-openssl-x509"
	depends on !BR2_STATIC_LIBS
	select BR2_PACKAGE_PERL_CRYPT_OPENSSL_RANDOM
	help
	  X509 encoding and decoding, using the openSSL libraries

	  https://metacpan.org/release/Crypt-OpenSSL-X509

comment "perl-crypt-openssl-x509 needs a toolchain w/ dynamic library"
	depends on BR2_STATIC_LIBS
```

## buildroot/package/perl-file-readbackwards/Config.in
```kconfig
config BR2_PACKAGE_PERL_FILE_READBACKWARDS
	bool "perl-file-readbackwards"
	help
	  Module to  Read a file backwards by lines

	  https://metacpan.org/release/File-ReadBackwards
```

## buildroot/package/perl-mime-types/Config.in
```kconfig
config BR2_PACKAGE_PERL_MIME_TYPES
	bool "perl-mime-types"
	depends on !BR2_STATIC_LIBS
	help
	  Definition of MIME types

	  https://metacpan.org/release/MIME-Types

comment "perl-mime-types needs a toolchain w/ dynamic library"
	depends on BR2_STATIC_LIBS
```

## buildroot/package/perl-template/Config.in
```kconfig
config BR2_PACKAGE_PERL_TEMPLATE
	bool "perl-template"
	depends on !BR2_STATIC_LIBS
	help
	  Front-end module to the Template Toolkit

	  https://metacpan.org/release/Template-Toolkit

comment "perl-template needs a toolchain w/ dynamic library"
	depends on BR2_STATIC_LIBS
```

## buildroot/package/perl-text-template/Config.in
```kconfig
config BR2_PACKAGE_PERL_TEXT_TEMPLATE
	bool "perl-text-template"
	depends on !BR2_STATIC_LIBS
	help
	  Expand template text with embedded Perl

	  https://metacpan.org/release/Text-Template

comment "perl-text-template needs a toolchain w/ dynamic library"
	depends on BR2_STATIC_LIBS
```

## buildroot/package/python-pyang/Config.in
```kconfig
config BR2_PACKAGE_PYTHON_PYANG
	bool "python-pyang"
	help
	  An extensible YANG (RFC 6020) validator. Provides a framwork for plugins that can convert YANG modules to other formats.

	  https://pypi.python.org/pypi/pyang
```

## buildroot/package/ttyd/Config.in
```kconfig
config BR2_PACKAGE_TTYD
	bool "ttyd"
	select BR2_PACKAGE_JSON_C
	select BR2_PACKAGE_LIBWEBSOCKETS
	select BR2_PACKAGE_LIBOPENSSL
	help
	  ttyd is a simple command-line tool for sharing terminal over the web.
```

## product/ubmc/package/Config.in
```kconfig
config BR2_PACKAGE_SILC_PRODUCT_NAME
    string "Product name"
    default UBMC

	source "../product/ubmc/package/ubmc_mgmtd/Config.in"
	source "../product/ubmc/package/ubmc_netconf/Config.in"
	source "../product/ubmc/package/ubmc_web/Config.in"
	source "../product/ubmc/package/is_console_manager/Config.in"
	source "../product/ubmc/package/is_ubmc_ipmi/Config.in"
	source "../product/ubmc/package/dying_gasp/Config.in"
```

## product/ubmc/package/dying_gasp/Config.in
```kconfig
config BR2_PACKAGE_DYING_GASP
	bool "dying gasp"
	help
	  Silicom Dying Gasp Application
```

## product/ubmc/package/is_console_manager/Config.in
```kconfig
config BR2_PACKAGE_IS_CONSOLE_MANAGER
	bool "is_console_manager"
	help
	  Silicom IS Console Manager Application
```

## product/ubmc/package/is_ubmc_ipmi/Config.in
```kconfig
config BR2_PACKAGE_IS_UBMC_IPMI
	bool "is_ubmc_ipmi"
	help
	  Silicom IS Ubmc Ipmi Application
```
