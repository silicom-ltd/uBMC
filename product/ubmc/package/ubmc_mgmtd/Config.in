## product/ubmc/package/ubmc_mgmtd/Config.in
```kconfig
config BR2_PACKAGE_UBMC_MGMTD
	bool "ubmc_mgmtd"
	help
	  Silicom uBMC management module
```

## product/ubmc/package/ubmc_netconf/Config.in
```kconfig
config BR2_PACKAGE_UBMC_NETCONF
	bool "ubmc_netconf"
	select BR2_PACKAGE_NETOPEER
	select BR2_PACKAGE_SILC_MGMTD
	help
	  uBMC NETCONF module
```

## product/ubmc/package/ubmc_web/Config.in
```kconfig
config BR2_PACKAGE_UBMC_WEB
	bool "ubmc_web"
	select BR2_PACKAGE_IS_WEB
	help
	  Silicom uBMC Web Interface.
```
